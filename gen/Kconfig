## gen/Kconfig
```kconfig
# Copyright (c) TOLOSAT 2026
# SPDX-License-Identifier: Apache-2.0

mainmenu "TAPAS Kernel Configuration"

config CONFIG_NAME
    string "Configuration Name"
    default "default"
    help
        The name of the configuration that will be used when saving or loading configs.

source "gen/Kconfig.platform"
source "gen/Kconfig.options"
```

## gen/Kconfig.platform
```kconfig
menu "Target Option"

choice
    prompt "Target Board"
    default BOARD_ART_PI
    help
        Select the target board for the build.

config BOARD_ART_PI
    bool "ART PI"
config BOARD_KLARA
    bool "KLARA"
config BOARD_QEMU
    bool "QEMU"
config BOARD_NUCLEO_H745ZI
    bool "Nucleo H745ZI"
config BOARD_NUCLEO_F411RE
    bool "Nucleo F411RE"

endchoice

if BOARD_ART_PI
source "bsp/ART_PI-BSP/Kconfig"
endif

if BOARD_KLARA
source "bsp/KLARA-BSP/Kconfig"
endif

if BOARD_QEMU
source "bsp/QEMU-BSP/Kconfig"
endif

if BOARD_NUCLEO_H745ZI
source "bsp/NUCLEO_H745ZI-BSP/Kconfig"
endif

if BOARD_NUCLEO_F411RE
source "bsp/NUCLEO_F411RE-BSP/Kconfig"
endif

endmenu # Target Option
```
